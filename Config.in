## Config.in
```kconfig
#
# This file is distributed as part of Xilinx ARM SDK
#
# Copyright (c) 2020 - 2021,  Xilinx, Inc.
# All rights reserved.
#
#mainmenu "ABuilder Configuration"

config SNIC_HAVE_DOT_CONFIG
	bool
	default y

config SNIC_VERSION
	string
	default "2010.05"

choice
prompt "Operating Mode"
	default SNIC_CUSTOMER
	help
	  Select development options.

config SNIC_CUSTOMER
	bool "Customer Suggested Options"
	help
	  Only supported features will be available.

config SNIC_DEVELOPER
	bool "Developer"
	help
	  Used by developers - no support available

endchoice

config SNIC_EXPERIMENTAL
	bool "Include experimental options"
	depends on SNIC_DEVELOPER
	help
	  Experimental features - no support available

config SNIC_USE_SUBVARIANT
	depends on SNIC_DEVELOPER
	bool "Specify a named subvariant"
	default n

config SNIC_SUBVARIANT
	depends on SNIC_USE_SUBVARIANT
	string "Subvariant name"
	default ""

config SNIC_MAKE_JOBS
	int "Number of simultaneous jobs a 'make' can launch (max 8)"
	default 4
	range 1 8
	help
	  Number of jobs allows to run parallel builds.

config SNIC_BUILD_INTREE
	bool "Build/Distro directories in current tree"
	default "y"
	help
	  Build and distro directories are created in tree. If 'no' is selected,
	  then build and distro directories shall be generated in the directory
	  above. This option is available for compatibility with previous release.

config SNIC_BUILD_PRESEED
	bool "Use Preseed Download directories"
	default "y"
	help
	  Preseed download directories from preseed tgz files
	  if available

config SNIC_RELEASE_VER
	string
	default "0.1"
	help
	  Release version

#config SNIC_DEBIAN_PACKAGES
#	bool "Build Debian packages"
#	default "n"
#	help
#	  Allow Debian packages to be created using a stamp name,
#	  if defined.

source target/Config.in

source package/Config.in

#endmenu
```

## package/Config.in
```kconfig
#
# This file is distributed as part of Xilinx ARM SDK
#
# Copyright (c) 2020 - 2021,  Xilinx, Inc.
# All rights reserved.
#
source package/u-boot/Config.in
source package/buildroot/Config.in
source package/initramfs/Config.in
source package/kernel/Config.in
source package/fit/Config.in
source package/boot/Config.in
source package/rootfs/Config.in
source package/firmware/Config.in
```

## package/boot/Config.in
```kconfig
#
# This file is distributed as part of Xilinx ARM SDK
#
# Copyright (c) 2020 - 2021,  Xilinx, Inc.
# All rights reserved.
#
config SNIC_PACKAGE_BOOT
	bool "Boot partition"
	depends on SNIC_PACKAGE_UBOOT
	default "y"

menu "Boot options"
	depends on SNIC_PACKAGE_BOOT

config SNIC_BOOT_UBOOT
	depends on SNIC_PACKAGE_UBOOT
	bool "Add custom bootscript for U-boot"
	default "y"

menu "U-Boot boot scripts"
	depends on SNIC_BOOT_UBOOT

choice
	prompt "Select which rootfs device to use"
	default SNIC_BOOT_MMC1

config SNIC_BOOT_MMC0
	bool "Boot from MMC0 (SD card)"

config SNIC_BOOT_MMC1
	bool "Boot from MMC1 (eMMC)"

endchoice

config SNIC_BOOT_PART
	string "Specify u-boot mmc boot partition for reading boot scr images"
	default "2"

config SNIC_BOOT_KERNPART
	string "Specify u-boot mmc boot partition for reading kernel"
	depends on SNIC_PACKAGE_KERNEL
	default "3"

config SNIC_BOOT_DTBPART
	string "Specify u-boot mmc boot partition for reading dtb images"
	depends on SNIC_PACKAGE_KERNEL
	default "2"

config SNIC_BOOT_ROOTFSPART
	string "Specify rootfs device partition (under /dev/) for kernel command line"
	default "p3"


config SNIC_BOOT_FIT_KERNEL
	depends on SNIC_PACKAGE_FIT
	bool "Add booting kernel via FIT image "
	default "n"


config SNIC_BOOT_COMPLEX
	bool "Complex booting from several alternatives"
	default "y"

choice
	prompt "Target Boot"
	default SNIC_BOOT_BOOTSCRIPT_COMPLEX
	help
	  Select target boot via initramfs, initrd or rootfs partition.

config SNIC_BOOT_BOOTSCRIPT_COMPLEX
	bool "Bootscript supporting many targets"

endchoice

if SNIC_BOOT_BOOTSCRIPT_COMPLEX

config SNIC_BOOT_HUGEPAGES_SIZE
	string "HugePages size"
	default "1024m"

config SNIC_BOOT_HUGEPAGES_NUM
	string "Number of HugePages to request"
	default "0"
	help
	  This eats ram in HUGEPAGES_SIZE chunks
endif


choice
	prompt "Select which booscript to use"

config SNIC_BOOT_COMPLEX_LINK
	depends on SNIC_BOOT_COMPLEX
	bool "Complex bootscript"

config SNIC_BOOT_KERNEL_INITRD_LINK
	depends on SNIC_FIT_KERNEL_INITRD && SNIC_BOOT_FIT_KERNEL
	bool "Initrd fit bootscript"

config SNIC_BOOT_KERNEL_ONLY_LINK
	depends on SNIC_FIT_KERNEL_ONLY && SNIC_BOOT_FIT_KERNEL
	bool "Kernel only fit bootscript"

config SNIC_BOOT_KERNEL_INITRAMFS_LINK
	depends on SNIC_FIT_KERNEL_INITRAMFS && SNIC_BOOT_FIT_KERNEL
	bool "Kernel with intramfs fit bootscript"

endchoice

endmenu

if SNIC_NXP

source package/boot/nxp/custom/Config.in
source package/boot/nxp/utils/Config.in

endif
endmenu
```

## package/boot/nxp/custom/Config.in
```kconfig
#
# This file is distributed as part of Xilinx ARM SDK
#
# Copyright (c) 2020 - 2021,  Xilinx, Inc.
# All rights reserved.
#
menu "Custom Boot Files"

config SNIC_BOOT_CUSTOM_INSTALLER
	bool "Rootfs Installer"
	default 'y'

config SNIC_BOOT_CUSTOM_INSTALLER_ROOTFS
	bool "Install current custom rootfs"
	depends on SNIC_BOOT_CUSTOM_INSTALLER
	default 'y'

config SNIC_BOOT_CUSTOM_UPDATER
	bool "Flash update tools"
	default 'y'

config SNIC_BOOT_CUSTOM_UPDATER_IMGS
	bool "Install flash images"
	depends on SNIC_BOOT_CUSTOM_UPDATER && SNIC_FIRMWARE_QORIQ_BOOT_IMAGES
	default 'y'

#config SNIC_BOOT_CUSTOM_INIT
#	bool "Custom init script"

endmenu
```

## package/boot/nxp/utils/Config.in
```kconfig
#
# This file is distributed as part of Xilinx ARM SDK
#
# Copyright (c) 2020 - 2021,  Xilinx, Inc.
# All rights reserved.
#
menu "Utilities"

config SNIC_BOOT_PARTITION_UTILITIES
	bool "Partitioning utilities"

endmenu
```

## package/buildroot/Config.in
```kconfig
#
# This file is distributed as part of Xilinx ARM SDK
#
# Copyright (c) 2020 - 2021,  Xilinx, Inc.
# All rights reserved.
#
config SNIC_PACKAGE_BUILDROOT
	bool "Buildroot Root Filesystem"
	default "n"

menu "Buildroot Options"
	depends on SNIC_PACKAGE_BUILDROOT

if SNIC_PACKAGE_BUILDROOT
choice
	prompt "Choose which buildroot version to build"
	default SNIC_BUILDROOT_FEB_2020

config SNIC_BUILDROOT_FEB_2020
	bool "Feb 2020 buildroot"

endchoice

choice
prompt "Components"
	default SNIC_BUILDROOT_DEFAULT_CONFIG
	help
	  Select buildroot rootfs components.

config SNIC_BUILDROOT_DEFAULT_CONFIG
	bool "Default"
	help
	  Default components - includes OVS.

config SNIC_BUILDROOT_CEPH_CONFIG
	bool "Default with Ceph support"
	help
	  Default components - includes OVS and Ceph.

endchoice

config SNIC_BUILDROOT_PRESEED
	bool "Preseed dowload directory"
	depends on SNIC_PACKAGE_BUILDROOT && SNIC_BUILD_PRESEED
	default "y"

endif

endmenu
```

## package/firmware/Config.in
```kconfig
#
# This file is distributed as part of Xilinx ARM SDK
#
# Copyright (c) 2020 - 2021,  Xilinx, Inc.
# All rights reserved.
#


config SNIC_PACKAGE_FIRMWARE
	bool "Build firmware"
	depends on SNIC_NXP
	default "y"
	help
	 This is a help example.

menu "Qoriq Options"
	depends on SNIC_PACKAGE_FIRMWARE && SNIC_NXP
source package/firmware/nxp/Config.in
endmenu
```

## package/firmware/nxp/Config.in
```kconfig
#
# This file is distributed as part of Xilinx ARM SDK
#
# Copyright (c) 2020 - 2021,  Xilinx, Inc.
# All rights reserved.
#

config SNIC_FIRMWARE_QORIQ
	depends on SNIC_PACKAGE_FIRMWARE && SNIC_NXP
	bool "Build QoriQ layerscape SoC firmware"
	default "y"

config SNIC_FIRMWARE_QORIQ_BOOT_IMAGES
	depends on SNIC_FIRMWARE_QORIQ
	bool "Build QoriQ layerscape composite firmware images"
	select SNIC_FIRMWARE_QORIQ_PBL_FIP
	select SNIC_FIRMWARE_QORIQ_DDR
	select SNIC_FIRMWARE_QORIQ_MC_UTILS
	select SNIC_FIRMWARE_QORIQ_MC
	select SNIC_FIT_NXP
	default "y"

config SNIC_FIRMWARE_QORIQ_BOOT_UEFI
	depends on SNIC_PACKAGE_UEFI
	bool "Use UEFI as BL33 boot image"
	default "n"

config SNIC_FIRMWARE_QORIQ_BOOT_IMAGES_2M
	depends on SNIC_FIRMWARE_QORIQ_BOOT_IMAGES
	bool "Build firmware image without Initramfs kernel"
	default "y"

config SNIC_FIRMWARE_QORIQ_BOOT_IMAGES_64M
	depends on SNIC_FIRMWARE_QORIQ_BOOT_IMAGES
	bool "Build firmware image including Initramfs kernel"
	select SNIC_FIT_KERNEL_INITRAMFS
	default "y"

config SNIC_FIRMWARE_DPAA2_DISABLED
	bool "Disable DPAA2 and Build firmware without QoriQ layerscape MC binaries and utilities"
	default "y"

config SNIC_FIRMWARE_QORIQ_DEBUG
	depends on SNIC_FIRMWARE_QORIQ
	bool "Select debug options for components (development only)"
	default "n"

config SNIC_FIRMWARE_QORIQ_RCW
	depends on SNIC_FIRMWARE_QORIQ
	bool "Build QoriQ layerscape RCW (ResetControlWord)"
	default "n"

config SNIC_FIRMWARE_QORIQ_RCW_REV2
	depends on SNIC_FIRMWARE_QORIQ_RCW
	bool "Build QoriQ layerscape RCW (ResetControlWord) for rev#2 silicon"
	default "y"

config SNIC_FIRMWARE_QORIQ_RCW_DEBUG
	depends on SNIC_FIRMWARE_QORIQ_RCW && SNIC_FIRMWARE_QORIQ_DEBUG
	bool "Build debug RCW"
	default "n"

config SNIC_FIRMWARE_QORIQ_ATF
	depends on SNIC_FIRMWARE_QORIQ
	bool "Build QoriQ layerscape ATF (ApiTrustedFirmware)"
	default "n"

config SNIC_FIRMWARE_QORIQ_ATF_DEBUG
	depends on SNIC_FIRMWARE_QORIQ_ATF && SNIC_FIRMWARE_QORIQ_DEBUG
	bool "Build QoriQ layerscape ATF (DEBUG)"
	default ""

config SNIC_FIRMWARE_QORIQ_PBL_FIP
	depends on SNIC_FIRMWARE_QORIQ
	bool "Build QoriQ layerscape pbl and fip firmware using u-boot"
	select SNIC_FIRMWARE_QORIQ_RCW
	select SNIC_FIRMWARE_QORIQ_ATF
	select SNIC_PACKAGE_UBOOT
	default "n"

config SNIC_FIRMWARE_QORIQ_PBL_FIP_DEBUG
	depends on SNIC_FIRMWARE_QORIQ_PBL_FIP && SNIC_FIRMWARE_QORIQ_DEBUG
	bool "Build debug pbl/fip"
	default "n"

config SNIC_FIRMWARE_QORIQ_PHY
	depends on SNIC_FIRMWARE_QORIQ && SNIC_DEVELOPER
	bool "Download QoriQ layerscape ethernet PHY firmware"
	default "n"

config SNIC_FIRMWARE_QORIQ_CORTINA
	depends on SNIC_FIRMWARE_QORIQ && SNIC_DEVELOPER
	bool "Download QoriQ layerscape cortina firmware"
	default "n"

config SNIC_FIRMWARE_QORIQ_PFE
	depends on SNIC_FIRMWARE_QORIQ && SNIC_DEVELOPER
	bool "Download QoriQ layerscape pfe engine binaries"
	default "n"

config SNIC_FIRMWARE_QORIQ_DDR
	depends on SNIC_FIRMWARE_QORIQ && SNIC_SOC_LX2160A
	bool "Download QoriQ layerscape ddr phy binaries"
	default "n"

config SNIC_FIRMWARE_QORIQ_MC
	depends on SNIC_FIRMWARE_QORIQ && !SNIC_FIRMWARE_DPAA2_DISABLED
	bool "Download QoriQ layerscape MC binaries"
	default "n"

config SNIC_FIRMWARE_QORIQ_MC_DEBUG
	depends on SNIC_FIRMWARE_QORIQ_MC && SNIC_FIRMWARE_QORIQ_DEBUG
	bool "Build debug MC"
	default "n"

config SNIC_FIRMWARE_QORIQ_MC_UTILS
	depends on SNIC_FIRMWARE_QORIQ && !SNIC_FIRMWARE_DPAA2_DISABLED
	bool "Build QoriQ layerscape MC utils firmware incl dpl and dpc dtbs"
	default "n"

config SNIC_FIRMWARE_QORIQ_MC_UTILS_DEBUG
	depends on SNIC_FIRMWARE_QORIQ_MC_UTILS && SNIC_FIRMWARE_QORIQ_DEBUG
	bool "Build debug MC_UTILS"
	default "n"

config SNIC_FIRMWARE_25G_ENABLE
    bool "Enable 25G interface"
    depends on SNIC_FIRMWARE_QORIQ && !SNIC_FIRMWARE_DPAA2_DISABLED
    default "n"
    help
     Enables 25G interface
```

## package/fit/Config.in
```kconfig
#
# This file is distributed as part of Xilinx ARM SDK
#
# Copyright (c) 2020 - 2021,  Xilinx, Inc.
# All rights reserved.
#
config SNIC_PACKAGE_FIT
	bool "FIT (Flattened Image Tree)"
	depends on SNIC_PACKAGE_UBOOT
	default "y"
	select SNIC_PACKAGE_KERNEL

menu "FIT options"
	depends on SNIC_PACKAGE_FIT

config SNIC_FIT_KERNEL_ONLY
	bool "Make u-boot kernel/rootfs fit kernel only image"
	default "y"
	select SNIC_KERNEL_BOOT

config SNIC_FIT_KERNEL_INITRD
	bool "Make u-boot kernel/rootfs fit kernel with intrd image"
	default "n"
	select SNIC_KERNEL_INITRD

config SNIC_FIT_KERNEL_INITRAMFS
	bool "Make u-boot kernel/rootfs fit kernel with intramfs image"
	default "y"
	select SNIC_KERNEL_INITRD

endmenu
```

## package/fit/nxp/lx2160a-initramfs.its
```
/*
 * Copyright 2017 NXP
 *
 */


/dts-v1/;

/ {
	description = "arm64 kernel, ramdisk and FDT blob";
	#address-cells = <1>;

	images {
		kernel {
			description = "ARM64 Kernel";
			data = /incbin/("ZIMAGE_INITRAMFS");
			
			type = "kernel";
			arch = "arm64";
			os = "linux";
			compression = "gzip";
			load = <0x80080000>;
			entry = <0x80080000>;
			hash@1 {
				algo = "crc32";
			};
		};

		BOARD-dtb {
			description = "BOARD-dtb";
			data = /incbin/("DTB");
			type = "flat_dt";
			arch = "arm64";
			os = "linux";
			compression = "none";
			load = <0x90000000>;
			hash@1 {
				algo = "crc32";
			};
		};
	};

	configurations {
		default = "BOARD";
		BOARD {
			description = "config for BOARD";
			kernel = "kernel";
			fdt = "BOARD-dtb";
		};
	};
};
```

## package/initramfs/Config.in
```kconfig
#
# This file is distributed as part of Xilinx ARM SDK
#
# Copyright (c) 2020 - 2021,  Xilinx, Inc.
# All rights reserved.
#
config SNIC_PACKAGE_INITRAMFS
	bool "Build initramfs package"
	default "y"

if SNIC_PACKAGE_INITRAMFS

menu "Initramfs Options"

config SNIC_INITRAMFS_BUILDROOT
	select SNIC_PACKAGE_BUILDROOT
	bool "Use buildroot initramfs"
	default "y"
	help
	  Use the buildroot root filesystem as initramfs source

config SNIC_INITRAMFS_PATH
	depends on !SNIC_INITRAMFS_BUILDROOT
	string "Specify path to initramfs cpio file"
	default "~/initramfs.cpio"
	help
	  Use an already generated initramfs
choice
prompt "IP Network Configuration"
	default SNIC_INITRAMFS_MANUAL

config SNIC_INITRAMFS_STATIC
	bool "Disable network interface"
	help
	  Do not assign any IP to interface

config SNIC_INITRAMFS_DHCP
	bool "Enable DHCP"
	help
	  Assign IP from dhcp server

config SNIC_INITRAMFS_STATIC
	bool "Enable Static IP"
	help
	  Assign static IP

endchoice

if SNIC_INITRAMFS_STATIC

config SNIC_INITRAMFS_STATIC_IP
    string "IP Address"
    default "192.168.1.1"

config SNIC_INITRAMFS_STATIC_SUBNET
    string "Subnet"
    default "255.255.255.0"

endif

config SNIC_INITRAMFS_CONFIG
    bool "Remote configuration management"
    default y

if SNIC_INITRAMFS_CONFIG

menu "Remote configuration server settings"

config SNIC_INITRAMFS_CONFIG_SERVER
    depends on SNIC_INITRAMFS_CONFIG
    string "Update server IP"
    default "0.0.0.0"

config SNIC_INITRAMFS_CONFIG_TRANSPORT
    depends on SNIC_INITRAMFS_CONFIG
    string "Update server transport protocol"
    default "http"

config SNIC_INITRAMFS_CONFIG_USER
    depends on SNIC_INITRAMFS_CONFIG
    string "Update server user (ssh)"
    default "root"

config SNIC_INITRAMFS_CONFIG_PORT
    depends on SNIC_INITRAMFS_CONFIG
    string "Update server port"
    default "80"

config SNIC_INITRAMFS_CONFIG_DIR
    depends on SNIC_INITRAMFS_CONFIG
    string "Update server directory"
    default "/u26z"

config SNIC_INITRAMFS_CONFIG_FILE
    depends on SNIC_INITRAMFS_CONFIG
    string "update filename"
    default "update.json"

endmenu

endif

endmenu

endif
```
